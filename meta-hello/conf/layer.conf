## meta-hello/conf/layer.conf
```bitbake
# Add the path of this layer to BBPATH
BBPATH .= ":${LAYERDIR}"


# Add recipes and append files to BBFILES
BBFILES += "${LAYERDIR}/recipes-*/*/*.bb \
            ${LAYERDIR}/recipes-*/*/*.bbappend"

# Set layer search pattern and priority
BBFILE_COLLECTIONS += "hello"
BBFILE_PATTERN_hello := "^${LAYERDIR}/"
BBFILE_PRIORITY_hello = "5"
```
